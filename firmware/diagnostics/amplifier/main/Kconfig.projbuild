## firmware/diagnostics/amplifier/main/Kconfig.projbuild
```kconfig
menu "Parse amplifier bench diagnostic"
config PARSE_BENCH_WIRING_CONFIRMED
    bool "MAX98357A power, speaker and GPIO wiring have been checked"
    default n
    help
        Only enable after checking the physical wiring. The diagnostic leaves
        all peripheral GPIOs untouched when this setting is disabled.
config PARSE_BENCH_BCLK_GPIO
    int "MAX98357A BCLK GPIO"
    range -1 48
    default -1
config PARSE_BENCH_WS_GPIO
    int "MAX98357A LRC/LRCLK GPIO"
    range -1 48
    default -1
config PARSE_BENCH_DATA_GPIO
    int "MAX98357A DIN GPIO"
    range -1 48
    default -1
config PARSE_BENCH_ENABLE_GPIO
    int "MAX98357A SD/enable GPIO (-1 if not connected to ESP32)"
    range -1 48
    default -1
config PARSE_BENCH_TONE_AMPLITUDE
    int "Peak test-tone amplitude (16-bit PCM)"
    range 1 8000
    default 1000
    help
        Keep diagnostic tones brief. 32767 is full scale; the default is
        about 3 percent. This setting changes only an explicitly requested tone.
endmenu
```

## firmware/diagnostics/amplifier/sdkconfig.defaults
```kconfig
CONFIG_IDF_TARGET="esp32s3"
CONFIG_PARTITION_TABLE_SINGLE_APP=y
CONFIG_PARSE_BENCH_BCLK_GPIO=-1
CONFIG_PARSE_BENCH_WS_GPIO=-1
CONFIG_PARSE_BENCH_DATA_GPIO=-1
CONFIG_PARSE_BENCH_ENABLE_GPIO=-1
# CONFIG_PARSE_BENCH_WIRING_CONFIRMED is not set
```

## firmware/diagnostics/microphone/main/Kconfig.projbuild
```kconfig
menu "Parse microphone diagnostic"
config PARSE_MIC_BLE
    bool "Use the Bluetooth bench transport instead of the optional Wi-Fi probe"
    default n
config PARSE_MIC_WIRING_CONFIRMED
    bool "INMP441 wiring and left channel have been confirmed"
    default n
config PARSE_MIC_BCLK_GPIO
    int "INMP441 SCK GPIO"
    range -1 48
    default -1
config PARSE_MIC_WS_GPIO
    int "INMP441 WS GPIO"
    range -1 48
    default -1
config PARSE_MIC_DATA_GPIO
    int "INMP441 SD GPIO"
    range -1 48
    default -1
config PARSE_MIC_AMP_ENABLE_GPIO
    int "Confirmed amplifier enable GPIO to hold low (-1 if absent)"
    range -1 48
    default -1
config PARSE_MIC_SPEAKER_ENABLED
    bool "Enable requested speaker playback with SD/EN tied to 3V3"
    default n
config PARSE_MIC_SPK_BCLK_GPIO
    int "MAX98357A BCLK GPIO"
    range -1 48
    default -1
config PARSE_MIC_SPK_WS_GPIO
    int "MAX98357A LRC/WS GPIO"
    range -1 48
    default -1
config PARSE_MIC_SPK_DATA_GPIO
    int "MAX98357A DIN GPIO"
    range -1 48
    default -1
endmenu
```

## firmware/diagnostics/microphone/sdkconfig.defaults
```kconfig
CONFIG_IDF_TARGET="esp32s3"
CONFIG_PARTITION_TABLE_SINGLE_APP=y
CONFIG_ESP_MAIN_TASK_STACK_SIZE=8192
CONFIG_MBEDTLS_CERTIFICATE_BUNDLE=y
CONFIG_MBEDTLS_CERTIFICATE_BUNDLE_DEFAULT_FULL=y
CONFIG_PARSE_MIC_BCLK_GPIO=-1
CONFIG_PARSE_MIC_WS_GPIO=-1
CONFIG_PARSE_MIC_DATA_GPIO=-1
CONFIG_PARSE_MIC_AMP_ENABLE_GPIO=-1
# CONFIG_PARSE_MIC_WIRING_CONFIRMED is not set
```

## firmware/main/Kconfig
```kconfig
menu "CareLoop hardware (supplier must confirm every pin)"
config CARELOOP_MIC_BCLK_GPIO
    int "INMP441 BCLK GPIO (-1 disables microphone)"
    default -1
config CARELOOP_MIC_WS_GPIO
    int "INMP441 WS GPIO (-1 disables microphone)"
    default -1
config CARELOOP_MIC_DATA_GPIO
    int "INMP441 SD GPIO (-1 disables microphone)"
    default -1
config CARELOOP_MIC_LEFT_CHANNEL
    bool "INMP441 selected channel is left"
    default y
config CARELOOP_SPK_BCLK_GPIO
    int "MAX98357A BCLK GPIO (-1 disables speaker)"
    default -1
config CARELOOP_SPK_WS_GPIO
    int "MAX98357A LRC GPIO (-1 disables speaker)"
    default -1
config CARELOOP_SPK_DATA_GPIO
    int "MAX98357A DIN GPIO (-1 disables speaker)"
    default -1
config CARELOOP_AMP_ENABLE_GPIO
    int "Amplifier enable GPIO (-1 if no enable pin)"
    default -1
config CARELOOP_AMP_ENABLE_ACTIVE_HIGH
    bool "Amplifier enable is active high"
    default y
config CARELOOP_PTT_GPIO
    int "Push-to-talk GPIO (-1 disables button)"
    default -1
config CARELOOP_PTT_ACTIVE_LOW
    bool "Push-to-talk is active low"
    default y
config CARELOOP_HAPTIC_GPIO
    int "Motor-driver enable GPIO (-1 disables haptics)"
    default -1
config CARELOOP_HAPTIC_ACTIVE_HIGH
    bool "Motor-driver enable is active high"
    default y
config CARELOOP_BATTERY_ADC_GPIO
    int "Battery-sense GPIO (-1 if unavailable)"
    default -1
endmenu
```

## firmware/sdkconfig.defaults
```kconfig
CONFIG_IDF_TARGET="esp32s3"
CONFIG_PARTITION_TABLE_CUSTOM=y
CONFIG_PARTITION_TABLE_CUSTOM_FILENAME="partitions.csv"
CONFIG_MBEDTLS_CERTIFICATE_BUNDLE=y
CONFIG_MBEDTLS_CERTIFICATE_BUNDLE_DEFAULT_FULL=y
CONFIG_ESP_TLS_USING_MBEDTLS=y
CONFIG_ESP_WIFI_SOFTAP_SUPPORT=y
CONFIG_I2S_SUPPRESS_DEPRECATE_WARN=y
CONFIG_LWIP_MAX_SOCKETS=10
CONFIG_ESP_MAIN_TASK_STACK_SIZE=8192

# ESP32-S3-WROOM-1 N16R8: 16 MB Quad flash and 8 MB Octal PSRAM.
CONFIG_ESPTOOLPY_FLASHSIZE_16MB=y
CONFIG_ESPTOOLPY_FLASHMODE_QIO=y
CONFIG_ESPTOOLPY_FLASHFREQ_80M=y
# CONFIG_ESPTOOLPY_OCT_FLASH is not set
CONFIG_SPIRAM=y
CONFIG_SPIRAM_MODE_OCT=y
CONFIG_SPIRAM_BOOT_INIT=y
CONFIG_SPIRAM_USE_CAPS_ALLOC=y
CONFIG_SPIRAM_SPEED_80M=y
```
